#include "ssd1306_safe.h"
#include <string.h>

#define SSD1306_ADDR_3C        (0x3CU << 1)
#define SSD1306_ADDR_3D        (0x3DU << 1)
#define SSD1306_TIMEOUT_MS     20U
#define SSD1306_CONTROL_CMD    0x00U
#define SSD1306_CONTROL_DATA   0x40U

static I2C_HandleTypeDef *ssd1306_i2c = NULL;
static uint16_t ssd1306_address = SSD1306_ADDR_3C;
static uint8_t ssd1306_ready = 0U;
static uint8_t ssd1306_buffer[SSD1306_WIDTH * SSD1306_PAGES];

static const uint8_t font5x7[96][5] =
{
    {0x00,0x00,0x00,0x00,0x00}, {0x00,0x00,0x5F,0x00,0x00},
    {0x00,0x07,0x00,0x07,0x00}, {0x14,0x7F,0x14,0x7F,0x14},
    {0x24,0x2A,0x7F,0x2A,0x12}, {0x23,0x13,0x08,0x64,0x62},
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    {0x10,0x08,0x08,0x10,0x08}, {0x00,0x00,0x00,0x00,0x00}
};

static uint8_t ssd1306_send(uint8_t control, const uint8_t *data, uint16_t size)
{
    uint8_t tx[129];

    if ((ssd1306_i2c == NULL) || (data == NULL) || (size > 128U))
    {
        return 0U;
    }

    tx[0] = control;
    memcpy(&tx[1], data, size);

    if (HAL_I2C_Master_Transmit(ssd1306_i2c,
                                ssd1306_address,
                                tx,
                                (uint16_t)(size + 1U),
                                SSD1306_TIMEOUT_MS) != HAL_OK)
    {
        return 0U;
    }

    return 1U;
}

static uint8_t ssd1306_command(uint8_t command)
{
    return ssd1306_send(SSD1306_CONTROL_CMD, &command, 1U);
}

static uint8_t ssd1306_command_list(const uint8_t *commands, uint8_t size)
{
    for (uint8_t i = 0U; i < size; i++)
    {
        if (ssd1306_command(commands[i]) == 0U)
        {
            return 0U;
        }
    }

    return 1U;
}

static uint8_t ssd1306_set_page(uint8_t page)
{
    uint8_t commands[3];

    if (page >= SSD1306_PAGES)
    {
        return 0U;
    }

    commands[0] = (uint8_t)(0xB0U | page);
    commands[1] = (uint8_t)(SSD1306_COLUMN_OFFSET & 0x0FU);
    commands[2] = (uint8_t)(0x10U | ((SSD1306_COLUMN_OFFSET >> 4) & 0x0FU));

    return ssd1306_command_list(commands, 3U);
}

uint8_t SSD1306_Init(I2C_HandleTypeDef *hi2c)
{
    static const uint8_t init_commands[] =
    {
        0xAE,       /* display off */
        0x20, 0x02, /* page addressing mode */
        0xB0,
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        0x8D, 0x14,
        0xAF
    };

    ssd1306_i2c = hi2c;
    ssd1306_ready = 0U;

    if (ssd1306_i2c == NULL)
    {
        return 0U;
    }

    HAL_Delay(100U);

    ssd1306_address = SSD1306_ADDR_3C;
    if (HAL_I2C_IsDeviceReady(ssd1306_i2c, ssd1306_address, 2U, SSD1306_TIMEOUT_MS) != HAL_OK)
    {
        ssd1306_address = SSD1306_ADDR_3D;
        if (HAL_I2C_IsDeviceReady(ssd1306_i2c, ssd1306_address, 2U, SSD1306_TIMEOUT_MS) != HAL_OK)
        {
            return 0U;
        }
    }

    ssd1306_ready = 1U;

    if (ssd1306_command_list(init_commands, (uint8_t)sizeof(init_commands)) == 0U)
    {
        return 0U;
    }

    SSD1306_ClearBuffer();
    return SSD1306_Update();
}

uint8_t SSD1306_IsReady(void)
{
    return ssd1306_ready;
}

void SSD1306_ClearBuffer(void)
{
    memset(ssd1306_buffer, 0x00, sizeof(ssd1306_buffer));
}

void SSD1306_Clear(void)
{
    SSD1306_ClearBuffer();
    (void)SSD1306_Update();
}

void SSD1306_ClearLine(uint8_t page)
{
    if (page >= SSD1306_PAGES)
    {
        return;
    }

    memset(&ssd1306_buffer[(uint16_t)page * SSD1306_WIDTH], 0x00, SSD1306_WIDTH);
    (void)SSD1306_UpdatePage(page);
}

static void ssd1306_draw_char_to_buffer(uint8_t page, uint8_t column, char character)
{
    uint8_t glyph_index;
    uint16_t buffer_index;

    if ((page >= SSD1306_PAGES) || (column >= SSD1306_WIDTH))
    {
        return;
    }

    if ((character < ' ') || (character > '~'))
    {
        character = '?';
    }

    glyph_index = (uint8_t)(character - ' ');

    for (uint8_t i = 0U; i < 5U; i++)
    {
        if ((column + i) >= SSD1306_WIDTH)
        {
            break;
        }

        buffer_index = ((uint16_t)page * SSD1306_WIDTH) + (uint16_t)column + i;
        ssd1306_buffer[buffer_index] = font5x7[glyph_index][i];
    }

    if ((column + 5U) < SSD1306_WIDTH)
    {
        buffer_index = ((uint16_t)page * SSD1306_WIDTH) + (uint16_t)column + 5U;
        ssd1306_buffer[buffer_index] = 0x00U;
    }
}

void SSD1306_PrintNoUpdate(uint8_t page, uint8_t column, const char *text)
{
    uint8_t current_column = column;

    if ((text == NULL) || (page >= SSD1306_PAGES) || (column >= SSD1306_WIDTH))
    {
        return;
    }

    while ((*text != '\0') && (current_column < (SSD1306_WIDTH - 5U)))
    {
        ssd1306_draw_char_to_buffer(page, current_column, *text);
        current_column = (uint8_t)(current_column + 6U);
        text++;
    }
}

void SSD1306_Print(uint8_t page, uint8_t column, const char *text)
{
    SSD1306_PrintNoUpdate(page, column, text);
    (void)SSD1306_UpdatePage(page);
}

void SSD1306_DrawPixel(uint8_t x, uint8_t y, uint8_t color)
{
    uint16_t buffer_index;

    if ((x >= SSD1306_WIDTH) || (y >= SSD1306_HEIGHT))
    {
        return;
    }

    buffer_index = ((uint16_t)(y / 8U) * SSD1306_WIDTH) + x;

    if (color != 0U)
    {
        ssd1306_buffer[buffer_index] |= (uint8_t)(1U << (y & 0x07U));
    }
    else
    {
        ssd1306_buffer[buffer_index] &= (uint8_t)~(1U << (y & 0x07U));
    }
}

void SSD1306_DrawRect(uint8_t x, uint8_t y, uint8_t width, uint8_t height, uint8_t color)
{
    if ((width == 0U) || (height == 0U))
    {
        return;
    }

    for (uint8_t i = 0U; i < width; i++)
    {
        SSD1306_DrawPixel((uint8_t)(x + i), y, color);
        SSD1306_DrawPixel((uint8_t)(x + i), (uint8_t)(y + height - 1U), color);
    }

    for (uint8_t j = 0U; j < height; j++)
    {
        SSD1306_DrawPixel(x, (uint8_t)(y + j), color);
        SSD1306_DrawPixel((uint8_t)(x + width - 1U), (uint8_t)(y + j), color);
    }
}

void SSD1306_FillRect(uint8_t x, uint8_t y, uint8_t width, uint8_t height, uint8_t color)
{
    for (uint8_t j = 0U; j < height; j++)
    {
        for (uint8_t i = 0U; i < width; i++)
        {
            SSD1306_DrawPixel((uint8_t)(x + i), (uint8_t)(y + j), color);
        }
    }
}

uint8_t SSD1306_UpdatePage(uint8_t page)
{
    if ((ssd1306_ready == 0U) || (page >= SSD1306_PAGES))
    {
        return 0U;
    }

    if (ssd1306_set_page(page) == 0U)
    {
        return 0U;
    }

    return ssd1306_send(SSD1306_CONTROL_DATA,
                        &ssd1306_buffer[(uint16_t)page * SSD1306_WIDTH],
                        SSD1306_WIDTH);
}

uint8_t SSD1306_Update(void)
{
    if (ssd1306_ready == 0U)
    {
        return 0U;
    }

    for (uint8_t page = 0U; page < SSD1306_PAGES; page++)
    {
        if (SSD1306_UpdatePage(page) == 0U)
        {
            return 0U;
        }
    }

    return 1U;
}

uint8_t OLED_Init(I2C_HandleTypeDef *hi2c)
{
    return SSD1306_Init(hi2c);
}

void OLED_Clear(void)
{
    SSD1306_Clear();
}

void OLED_Print(uint8_t page, uint8_t column, const char *text)
{
    SSD1306_Print(page, column, text);
}
